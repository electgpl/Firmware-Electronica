#include <16F883.h>
#device adc=8
#use delay(int=4000000)
const int sintable[] = {
0x80,0x83,0x86,0x89,0x8c,0x8f,0x92,0x95,
0x98,0x9c,0x9f,0xa2,0xa5,0xa8,0xab,0xae,
0xb0,0xb3,0xb6,0xb9,0xbc,0xbf,0xc1,0xc4,
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0x6a,0x6d,0x70,0x73,0x76,0x79,0x7c,0x80,
}; 
const int tritable[] = {
0x02,0x04,0x06,0x08,0x0a,0x0c,0x0e,0x10,
0x12,0x14,0x16,0x18,0x1a,0x1c,0x1e,0x20,
0x22,0x24,0x26,0x28,0x2a,0x2c,0x2e,0x30,
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0x0e,0x0c,0x0a,0x08,0x06,0x04,0x02,0x00,
}; 
const int dectable[] = {
0xff,0xf5,0xec,0xe3,0xda,0xd2,0xca,0xc2,
0xba,0xb3,0xac,0xa6,0x9f,0x99,0x93,0x8e,
0x88,0x83,0x7e,0x79,0x74,0x70,0x6c,0x67,
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0x0,0x0,0x0,0x0,0x0,0x0,0x0,0x0,
}; 
int8 i, sec=1, time=0;
void main(){ 
   setup_adc_ports(sAN1|VSS_VDD);
   setup_adc(ADC_CLOCK_DIV_2);
   while(true){ 
      for(i=0;i<256;i++){
         set_adc_channel(1);
         time=read_adc();
         if(input(PIN_A0)==1)
            delay_ms(30);
            if(input(PIN_A0)==1)
               sec=1; 
         if(sec==1){
            output_b(tritable[i]);
            delay_us(time+1);
         }
         if(input(PIN_A0)==1)
            delay_ms(30);
            if(input(PIN_A0)==1)
               sec=2;
         if(sec==2){
            output_b(sintable[i]);
            delay_us(time+1);
         }
         if(input(PIN_A0)==1)
            delay_ms(30);
            if(input(PIN_A0)==1)
               sec=3;
         if(sec==3){
            output_b(dectable[i]);
            delay_us(time+1);
         }
         if(input(PIN_A0)==1)
            delay_ms(30);
            if(input(PIN_A0)==1)
               sec=1;
      }
   }
}