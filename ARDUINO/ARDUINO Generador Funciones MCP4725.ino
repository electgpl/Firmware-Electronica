#include <Wire.h>
#include <Adafruit_MCP4725.h>
int funciones = 0;
int frecuencia = 0;

Adafruit_MCP4725 dac;

const PROGMEM uint16_t DACLookup_Sine_100[100] =
{
 2048, 2176, 2304, 2431, 2557, 2680, 2801, 2919,
 3034, 3145, 3251, 3353, 3449, 3540, 3625, 3704,
 3776, 3842, 3900, 3951, 3995, 4031, 4059, 4079,
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 1538, 1664, 1791, 1919
};

const PROGMEM uint16_t DACLookup_Triangle_100[100] =
{
    0,   82,  164,  246,  328,  410,  491,  573, 
  655,  737,  819,  901,  983, 1065, 1147, 1229,
 1310, 1392, 1474, 1556, 1638, 1720, 1802, 1884,
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  328,  246,  164,   82 
};

const PROGMEM uint16_t DACLookup_Saw_100[100] =
{
    0,   41,   82,  123,  164,  205,  246,  287, 
  328,  369,  410,  451,  491,  533,  573,  615,
  655,  697,  737,  779,  819,  861,  901,  943, 
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 3931, 3973, 4013, 4095
};

void setup(void){
   dac.begin(0x62);
   pinMode(2, INPUT_PULLUP);
   attachInterrupt(digitalPinToInterrupt(2), funcion, LOW);
}

void senoidal(void){
   uint16_t i;
   for(i = 0; i < 100; i++){
      dac.setVoltage(pgm_read_word(&(DACLookup_Sine_100[i])), false);
      delayMicroseconds(frecuencia);
   }
}

void triangular(void){
   uint16_t i;
   for(i = 0; i < 100; i++){
      dac.setVoltage(pgm_read_word(&(DACLookup_Triangle_100[i])), false);
      delayMicroseconds(frecuencia);
   }
}

void dienteUp(void){
   uint16_t i;
   for(i = 0; i < 100; i++){
      dac.setVoltage(pgm_read_word(&(DACLookup_Saw_100[i])), false);
      delayMicroseconds(frecuencia);
   } 
}

void funcion(void){
   if(funciones<4)
      funciones++;
   if(funciones==3)
      funciones=0;
}

void loop(void){
   frecuencia = analogRead(A0)+1;
   switch(funciones){
   case 0:
      senoidal();
      break;      
   case 1:
      triangular();
      break;
   case 2:
      dienteUp();
      break;
   default:
      break;  
   }
}
